/*
 * pg9616.cpp
 *
 *  Created on: Oct 8, 2008
 *      Author: bistromath
 */

extern "C" {
#include "stm32f10x.h"
#include "stm32f10x_conf.h"
#include <stdlib.h>
#include <string.h>
#include <math.h>
}

#include "pg9616.hpp"

void pg9616::select(u8 display)
{
}

void pg9616::select_all(void) {
}

void pg9616::init(void)
{
    extern void delay_ms(u16);
    extern void delay_us(u32);

    I2C_InitTypeDef i2cinit;

    I2C_Cmd(i2cdev, ENABLE);
    i2cinit.I2C_Mode = I2C_Mode_I2C;
    i2cinit.I2C_DutyCycle = I2C_DutyCycle_2; //using 16_9 makes display corruption worse, perhaps we are clocking in on the wrong edge?
    i2cinit.I2C_Ack = I2C_Ack_Disable;
    i2cinit.I2C_AcknowledgedAddress = I2C_AcknowledgedAddress_7bit;
    i2cinit.I2C_ClockSpeed = 100000; //1200000 max but using 1200000 is probably not too wise
    i2cinit.I2C_OwnAddress1 = 0x0000; //why do i care?

    I2C_Init(i2cdev, &i2cinit);
    I2C_StretchClockCmd(i2cdev, ENABLE);

    memset(printbuf, 0x00, NUM_DISPLAYS*96*2);
    memset(dblbuf, 0x00, NUM_DISPLAYS*96*2);

    GPIO_InitTypeDef GPIO_InitStructure;
    GPIO_InitStructure.GPIO_Pin = resetpin.pin;
    GPIO_InitStructure.GPIO_Speed = GPIO_Speed_10MHz;
    GPIO_InitStructure.GPIO_Mode = GPIO_Mode_Out_PP;
    GPIO_Init(resetpin.port, &GPIO_InitStructure);

    GPIO_ResetBits(resetpin.port, resetpin.pin);
    delay_us(4);
    GPIO_SetBits(resetpin.port, resetpin.pin);
    delay_us(4);

    select_all();
    OLED_Init();
    while(busy());

    //here we want to start the reluctant charge pumps
    select_all();
    Fill_RAM(0xAA);

    for(int i = 0; i < 3; i++) {
        Set_Charge_Pump(0x00);
        delay_ms(20);
        Set_Charge_Pump(0x04);
        delay_ms(20);
    }

    Fill_RAM(0x00);
    select(0);
}

void pg9616::OLED_Init(void)
{
    extern void delay_ms(u16 delay);

    Set_Display_On_Off(0x00); // Display Off (0x00/0x01)
    Set_Display_Clock(0xA2); // Set Clock as 120 Frames/Sec (0xA2)
    Set_Multiplex_Ratio(0x0F); // 1/16 Duty (0x0F~0x3F)
    Set_Display_Offset(0x00); // Shift Mapping RAM Counter (0x00~0x3F)
    Set_Start_Line(0x00); // Set Mapping RAM Display Start Line (0x00~0x3F)
    Set_Charge_Pump(0x04); // Enable Embedded DC/DC Converter (0x00/0x04)
    Set_Power_Save(0x00); // Set Low Power Save Mode
    Set_Addressing_Mode(0x02); // Set Page Addressing Mode (0x00/0x01/0x02)
    Set_Segment_Remap(0x01); // Set SEG/Column Mapping (0x00/0x01)
    Set_Common_Remap(0x08); // Set COM/Row Scan Direction (0x00/0x08)
    Set_Common_Config(0x00); // Set Sequential Configuration (0x00/0x10)
    Set_Contrast_Control(0xFF); // Set SEG Output Current 0xFF OK
    Set_Precharge_Period(0xD2); // Set Pre-Charge as 13 Clocks & Discharge as 2 Clock 0xD2 default
    Set_VCOMH(0x20); // Set VCOM Deselect Level
    Set_Entire_Display(0x00); // Disable Entire Display On (0x00/0x01)
    Set_Inverse_Display(0x00);

    Fill_RAM(0x00);

    delay_ms(10);
    Set_Display_On_Off(0x01); // Display On (0x00/0x01)
}

void pg9616::Fill_RAM(unsigned char Data)
{
	unsigned char i;
	u8 buf[128];
	memset(buf, Data, 128);

	for(i=0;i<8;i++)
	{
		Set_Start_Page(i);
		Set_Start_Column(0x00);
		Write_Data(buf, 128);
	}
}

void pg9616::Show_Pattern(u8 display, const unsigned char Data_Pointer[][2], unsigned char start_page, unsigned char start_col, unsigned char width)
{
    for(int i=0; i<width; i++) { printbuf[display][start_page][start_col+i] = Data_Pointer[i][0]; }
    for(int i=0; i<width; i++) { printbuf[display][start_page+1][start_col+i] = Data_Pointer[i][1]; }
//	memcpy(&printbuf[display][start_page][start_col], &Data_Pointer[0][0], width);
//	memcpy(&printbuf[display][start_page+1][start_col], &Data_Pointer[0][1], width);
}

void pg9616::print(u8 display, const char *string, Display_FontSizeTypeDef font, u8 line, u8 start_pos, s8 offset)
{
	//this version will print to a buffer instead of printing in real-time. the buffer gets diff'ed with the current screen and sent by calling ::update().
	//we are not invoking sprintf() because it's huge and it sucks.
	//DO NOT FORGET TO CALL THIS WITH A NULL-TERMINATED STRING! Const strings are null-terminated by the compiler.
	u8 i = 0;
    switch(font) {
	default:
	case Font_Small:
		i = start_pos * (FONT_SMALL_WIDTH+1)+offset;
		while(*string) {
			for(int j=0; j < FONT_SMALL_WIDTH; j++) {
				printbuf[display][line][i+j] = smallfont[*string-32][j];
			}
			printbuf[display][line][i+FONT_SMALL_WIDTH] = 0x00;
			i += FONT_SMALL_WIDTH + 1;
			string++;
		}
		break;

	case Font_Large:
		i = start_pos * (FONT_LARGE_WIDTH + FONT_LARGE_CHAR_SPACING);
		while(*string) {
			for(int j=0; j < FONT_LARGE_WIDTH; j++) {
				printbuf[display][line][i+j] = largefont[*string-32][j][0];
				printbuf[display][line+1][i+j] = largefont[*string-32][j][1];
			}
			for(int k = 0; k < FONT_LARGE_CHAR_SPACING; k++) {
				printbuf[display][line][i+FONT_LARGE_WIDTH+k] = 0x00;
				printbuf[display][line+1][i+FONT_LARGE_WIDTH+k] = 0x00;
			}
			i += FONT_LARGE_WIDTH + FONT_LARGE_CHAR_SPACING;
			string++;
		}
		break;
	}
}

void pg9616::update(u8 display) {
	//this does diffs against the last sent screens, and sends required data out to the display.
	u8 txbuffer[99];
	u8 txpos = 0x00;
	u8 current_page = 0xFF;
	u8 current_display = 0xFF;
	//select(display);
	for(int k = 0; k < 2; k++) { //k over 2 pages to display (not using pages 2 and 3)
		//Set_Start_Page(k); //right now this is repeated 2x every update, and doesn't have to be.
		for(int j = 0; j < 96; j++) { //j over columns
			//diffs[i][j][k] = printbuf[i][j][k] ^ dblbuf[i][j][k];
			if(printbuf[display][k][j] != dblbuf[display][k][j]) { //if there's a difference between the current print buffer and the last sent buffer at this column
				if(txpos == 0) { //this means this is the first in a series of contiguous differences
					//if(current_display != display) { //we'll select() the proper display since we'll have to send data, avoids unnecessary select() calls
					//	select(display);
					//	current_display = display;
					//}
					if(current_page != k) {
						Set_Start_Page(k);
						current_page = k;
					}
					Set_Start_Column(j); //set a start column for the txbuffer
				}
				txbuffer[txpos++] = printbuf[display][k][j];
			} else {
				if(txpos != 0) { //there's data to send
					//here we send data
					Write_Data(txbuffer, txpos);
					txpos = 0;
				}
			}
		}
		if(txpos != 0) { //takes care of the tail case where printbuf[x][96][x] != dblbuf[x][96][x]
			Write_Data(txbuffer, txpos);
			txpos = 0;
		}
	}

	memcpy(&dblbuf[display][0][0], &printbuf[display][0][0], 96*2);
	//memset(&printbuf[display][0][0], 0x00, 96*2);
}

void pg9616::update(void){
	for(int i = 0; i < NUM_DISPLAYS; i++) {
		update(i);
	}
}

void pg9616::print(u8 display, float number, Display_FontSizeTypeDef font, u8 width, u8 start_page, u8 start_col, bool plusminus, u8 max_decimals, s8 offset)
{
	char str[20];
	unsigned char index, i=0;
	unsigned long integer;

	if(number<0) {
		str[i++] = '-';
		number = 0 - number;
	} else {
		if(plusminus) str[i++] = '+';
	}

	integer = number;

	int digits = 0;

	do {
		digits++;
		integer /= 10;
	} while (integer != 0);

	//now "digits" has the number of integer digits in the number. given this and the "width" parameter, we can calculate the number of decimal digits we can
	//display. at this point, i contains the result of the plusminus thing, and can be used to calculate width.
	//for our uses, we want to right-justify to width. is this true? for K, yes. for duv, yes. for brightness, yes. for hue, yes. okay, let's say it's true.
	//if rounding results in a whole number, or zeroes out to width, do we truncate? for duv, no. for hue, yes.
	//for hue we want 0.0, 360.0, just a fixed precision. for duv we want the same. for percent, we want a fixed precision except where width would truncate the
	//100.0% to 100.%
	//would it work to have a max decimal parameter, which would limit precision to x digits after the decimal? combined with the width field, this would do it.
	//whichever is less, calculated decimal width or max_decimal.

	//right.

	int decimal_width = width - i - 1 - digits; //the 1 is for the decimal point. how do we truncate the decimal point? just don't add it if decimal_width <= 0.

	while(decimal_width > int(max_decimals)) {
		str[i++] = ' ';
		decimal_width--; //so we can right-justify
	}

	//here print the decimal part in the appropriate place
	if(decimal_width <= 0) {
		str[i++] = ' '; //right-justify to take care of the missing decimal point
		integer = (number + 0.5); //round it off if there are no decimals
	} else integer = number;

	long dec_exp = 1;
	for(int i = 0; i < decimal_width; i++) dec_exp *= 10;
	float decimal = number - int(number); //remove the integer part
	decimal = ((decimal * dec_exp) + 0.5) / float(dec_exp); //round to sig figs so you don't print 0.99999999.....
	if(decimal >= 1) {
		decimal -= 1.00;
		integer += 1;
	}

	index = 20;
	do {
	  str[--index] = '0' + integer % 10;
	  integer /= 10;
	} while (integer != 0);
	do { //left-justify
	    str[i++] = str[index++];
	} while ( index < 20 );

	//now i has the position of the decimal point, if any
	if(i < width) {
		str[i++] = '.';
	}

	while(i<width) {
		decimal *= 10; //so now decimal is 10
		str[i++] = int(decimal) + '0'; //int(10) + '0' is ':'
		decimal = decimal - int(decimal);
	}
	str[i] = 0x00;
	print(display, str, font, start_page, start_col, offset);
}

void pg9616::print(u8 display, signed long number, Display_FontSizeTypeDef font, u8 width, u8 start_page, u8 start_col, s8 offset)
{
	print_base(display, number, 10, font, width, start_page, start_col, offset);
}

void pg9616::print_base(u8 display, signed long number, u8 base, Display_FontSizeTypeDef font, u8 width, u8 start_page, u8 start_col, s8 offset)
{
	char str[10];
	u8 digits=0;
	signed long j=number;

	while(j) { //get the number of digits
		digits++;
		j /= base;
	}
	if(number == 0) digits = 1; //manual
	if(number < 0) digits++; //take care of the '-' sign
	if(digits > width) return; //should throw an exception but whatever

	u8 temp = width-digits;
	itoa(number, str + temp, base);

	while(temp) {
		str[--temp] = ' ';
	}

	print(display, str, font, start_page, start_col, offset);

}

/* reverse:  reverse string s in place */
void pg9616::reverse(char s[])
{
    int c, i, j;

    for (i = 0, j = strlen(s)-1; i<j; i++, j--) {
        c = s[i];
        s[i] = s[j];
        s[j] = c;
    }
}

char *pg9616::itoa(signed long value, char *result, int base)
{
	// check that the base if valid
	if (base < 2 || base > 16) { *result = 0; return result; }

	char* out = result;
	signed long quotient = value;

	do {
		*out = "0123456789ABCDEF"[ abs(quotient % base) ];
		++out;
		quotient /= base;
	} while ( quotient );

	// Only apply negative sign for base 10
	if ( value < 0 && base == 10) *out++ = '-';

	*out = 0;
	reverse( result );

	return result;

}

const unsigned char pg9616::smallfont[241][5] = {// Refer to "Times New Roman" Font Database...
		//   Basic Characters
		{0x00,0x00,0x00,0x00,0x00},		//
		{0x00,0x00,0x4F,0x00,0x00},		//   (  1)  ! - 0x0021 Exclamation Mark
		{0x00,0x07,0x00,0x07,0x00},		//   (  2)  " - 0x0022 Quotation Mark
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		{0x74,0x42,0x41,0x42,0x74},		//   (240)    - 0x2302 House
};

const unsigned char pg9616::largefont[95][8][2] = { //Bitstream Vera Bold
	{{0x0, 0x0}, {0x0, 0x0}, {0x0, 0x0}, {0x0, 0x0}, {0x0, 0x0}, {0x0, 0x0}, {0x0, 0x0}, {0x0, 0x0}},
	{{0x0, 0x0}, {0x0, 0x0}, {0x0, 0x0}, {0xfe, 0x19}, {0xfe, 0x19}, {0x0, 0x0}, {0x0, 0x0}, {0x0, 0x0}},
	{{0x0, 0x0}, {0x1e, 0x0}, {0x1e, 0x0}, {0x0, 0x0}, {0x0, 0x0}, {0x1e, 0x0}, {0x1e, 0x0}, {0x0, 0x0}},
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	{{0x0, 0x0}, {0x1c, 0x0}, {0x3e, 0x0}, {0x36, 0x0}, {0x3e, 0x0}, {0x1c, 0x0}, {0x0, 0x0}, {0x0, 0x0}},
};

const unsigned char pg9616::logo[12][2] = {{0xf, 0xc0}, {0xf, 0xf0}, {0xf, 0xfc}, {0xf, 0xff}, 
										   {0xc3, 0xff}, {0xf0, 0xff}, {0xfc, 0xff}, {0xff, 0xf3}, 
										   {0xff, 0xf0}, {0x3f, 0xf0}, {0x7, 0xf0}, {0x1, 0xf0}};
const unsigned char pg9616::logoname[50][2] = {{0x30, 0x18}, {0x30, 0x1c}, {0x30, 0x1f}, {0xb0, 0x1b}, 
		                                       {0xf0, 0x19}, {0x70, 0x18}, {0x30, 0x18}, {0x0, 0x0}, 
											   {0x30, 0x0}, {0xf0, 0xc0}, {0xc0, 0xe3}, {0x0, 0x7f}, 
											   {0x0, 0x3e}, {0x80, 0xf}, {0xf0, 0x1}, {0x70, 0x0}, 
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											   {0x30, 0x18}, {0x10, 0x18}};

